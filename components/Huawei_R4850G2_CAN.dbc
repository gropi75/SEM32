VERSION "V1beta"

NS_ :

BS_:

BU_: R4850G2 BatteryManager

BO_ 2424389759 ResponseData: 8 R4850G2
 SG_ Command M : 8|8@1+ (1,0) [0|0] ""  BatteryManager
 SG_ InputPower m112 : 32|32@1+ (0.0009765625,0) [0|0] "W"  BatteryManager
 SG_ InputFrequency m113 : 32|32@1+ (0.0009765625,0) [0|0] "Hz"  BatteryManager
 SG_ InputVoltage m120 : 32|32@1+ (0.0009765625,0) [0|0] "V"  BatteryManager

BO_ 2424324350 RequestData: 1 BatteryManager
 SG_ RequestData : 0|8@1+ (1,0) [0|0] ""  R4850G2

BO_ 2424406270 SetDAta: 8 BatteryManager
 SG_ WriteCommand M : 0|16@1+ (1,0) [0|0] ""  R4850G2
 SG_ OnlineOutputVoltage m256 : 32|32@1+ (1020,0) [42330|59670] "V"  R4850G2

CM_ BU_ R4850G2 "Power Supply";
CM_ BU_ BatteryManager "Battery Manager";
VAL_ 2424389759 Command 112 "InputPower" 113 "Input Frequency" 114 "Input Current" 115 "Output Power" ;
